## meta-tempercrate-bsp/conf/layer.conf
```bitbake
BBPATH .= ":${LAYERDIR}"

BBFILES += "${LAYERDIR}/recipes-*/*/*.bb \
            ${LAYERDIR}/recipes-*/*/*.bbappend"

BBFILE_COLLECTIONS += "tempercrate-bsp"
BBFILE_PATTERN_tempercrate-bsp = "^${LAYERDIR}/"
BBFILE_PRIORITY_tempercrate-bsp = "7"

LAYERSERIES_COMPAT_tempercrate-bsp = "scarthgap"
LAYERDEPENDS_tempercrate-bsp = "core"

# Override ST EULA handling for custom machines
EULA_FILE_ST:stm32mpcommon = "${OPENSTLINUX_BASE}/files/licenses/ST-Proprietary"
EULA_FILE_ST_MD5SUM:stm32mpcommon = "7cb1e55a9556c7dd1a3cae09db9cc85f"
```

## meta-tempercrate-bsp/conf/machine/stm32mp13-tempercrate-dev.conf
```bitbake
# Reuse the vendor (ST) machine settings as baseline
# (SoC, boot chain, kernel provider, storage layout, etc.).
require conf/machine/stm32mp13-disco.conf

# Give the machine its own identity.
MACHINE_NAME = "STM32MP13 TemperCrate DEV (based on Discovery)"
MACHINEOVERRIDES:append = ":stm32mp13-tempercrate-dev"

# Device Tree to build/deploy for this machine.
# "st/" is the subfolder under arch/arm/boot/dts/ in the kernel tree.
# The .dtb name must match the .dts provided via the kernel bbappend.
KERNEL_DEVICETREE = "st/stm32mp135f-tempercrate-dev.dtb"

# Enable FIT image support for this machine.
# In the ST BSP this automatically switches:
# - KERNEL_IMAGETYPE to fitImage
# - KERNEL_CLASSES to kernel-fitimage
# - extlinux handling to FIT-aware mode
MACHINE_FEATURES += "fit"

# Select the default DTB configuration used by the FIT image.
# Use the deployed DTB filename, without the source-tree path.
FIT_CONF_DEFAULT_DTB = "stm32mp135f-tempercrate-dev.dtb"

# Optional: use this to clearly differentiate artifacts
# when deploying images for multiple machines.
# IMAGE_BASENAME = "tempercrate-image-core-dev"
```

## meta-tempercrate-bsp/conf/machine/stm32mp13-tempercrate-prod.conf
```bitbake
# Reuse the vendor (ST) machine settings as baseline.
# Later you can replace this baseline if your production board diverges significantly.
require conf/machine/stm32mp13-disco.conf

# Give the machine its own identity
MACHINE_NAME = "STM32MP13 TemperCrate PROD (initially based on Discovery)"
MACHINEOVERRIDES:append = ":stm32mp13-tempercrate-prod"

# Device Tree to build/deploy for the production board.
KERNEL_DEVICETREE = "st/stm32mp135f-tempercrate-prod.dtb"

# Optional: differentiate artifacts
#IMAGE_BASENAME = "tempercrate-image-core-prod"
```

## meta-tempercrate-os/conf/distro/include/tempercrate-sdk.inc
```bitbake
# TemperCrate SDK content (target sysroot)
#TOOLCHAIN_TARGET_TASK:append = " paho-mqtt-c-dev paho-mqtt-cpp-dev networkmanager-dev"
#TOOLCHAIN_TARGET_TASK:append = " glib-2.0-dev"
#TOOLCHAIN_TARGET_TASK:append = " dbus-dev"
#TOOLCHAIN_TARGET_TASK:append = " boost-dev"
#TOOLCHAIN_TARGET_TASK:append = " libmodbus-dev"




# ================================
# TemperCrate SDK – Target sysroot content
# ================================

# GPIO
TOOLCHAIN_TARGET_TASK:append = " libgpiod-dev"

# OpenSSL / TLS
TOOLCHAIN_TARGET_TASK:append = " openssl-dev"

# Boost (headers + C++ components)
TOOLCHAIN_TARGET_TASK:append = " boost-dev"

# D-Bus
TOOLCHAIN_TARGET_TASK:append = " dbus-dev"

# GLib / GObject
TOOLCHAIN_TARGET_TASK:append = " glib-2.0-dev"

# Bluetooth (BlueZ)
TOOLCHAIN_TARGET_TASK:append = " bluez5-dev"

# SQLite
TOOLCHAIN_TARGET_TASK:append = " libsqlite3-dev"
#TOOLCHAIN_TARGET_TASK:append = " sqlite3"

# MQTT (Paho)
TOOLCHAIN_TARGET_TASK:append = " paho-mqtt-c-dev"
TOOLCHAIN_TARGET_TASK:append = " paho-mqtt-cpp-dev"

# Modbus
TOOLCHAIN_TARGET_TASK:append = " libmodbus-dev"

# Avahi (mDNS / Zeroconf client)
TOOLCHAIN_TARGET_TASK:append = " avahi-dev"

# NetworkManager (libnm)
TOOLCHAIN_TARGET_TASK:append = " networkmanager-dev"

# ModemManager (libmm-glib)
TOOLCHAIN_TARGET_TASK:append = " modemmanager-dev"

# FT4222 vendor library
TOOLCHAIN_TARGET_TASK:append = " ft4222-dev"
```

## meta-tempercrate-os/conf/distro/tempercrate-linux.conf
```bitbake
#@NAME: tempercrate-linux
#@DESCRIPTION: TemperCrate Linux based on ST Open Linux

# Base ST
require conf/distro/openstlinux-weston.conf
require conf/distro/include/tempercrate-sdk.inc

# Pin libgpiod major version (distro policy)
PREFERRED_VERSION_libgpiod = "1.6.%"

# =========================================================================
# DISTRO_VERSION from meta-tempercrate Git tag (exact match), else "0.0.0"
# =========================================================================
DISTRO = "tempercrate-linux"
DISTRO_NAME = "TemperCrate Linux"
DISTRO_CODENAME = "scarthgap"

# Default (development builds)
DISTRO_VERSION = "0.0.0"

# Use the exact Git tag of meta-tempercrate HEAD, if any; otherwise keep 0.0.0
DISTRO_VERSION := "${@(lambda repo: (__import__('os').popen('git -C %s describe --tags --exact-match 2>/dev/null' % __import__('shlex').quote(repo)).read().strip() or '0.0.0') if repo else '0.0.0')(d.getVar('TEMPERCRATE_META_REPO_DIR') or '')}"

# Set root filesystem size to 512 MiB.
# IMAGE_ROOTFS_SIZE is expressed in KiB:
#   256 MiB × 1024 KiB/MiB = 262144 KiB. 262144
# IMAGE_OVERHEAD_FACTOR is set to 1.0 to avoid automatic size inflation
# and keep the generated ext4 image close to the requested size.
# Rootfs size policy: apply only to TemperCrate rootfs images (not to ST initramfs images)
IMAGE_ROOTFS_SIZE:pn-tempercrate-image-debug = "262144"
IMAGE_OVERHEAD_FACTOR:pn-tempercrate-image-debug = "1.0"

IMAGE_ROOTFS_SIZE:pn-tempercrate-image-core = "262144"
IMAGE_OVERHEAD_FACTOR:pn-tempercrate-image-core = "1.0"

# ============================================================
# QA policy
# ============================================================
#
# Disable Y2038 (32bit time_t) QA warnings.
#
# Rationale:
# - Target is embedded STM32MP13 (32-bit userspace)
# - Expected device lifetime < 2038
# - Affects legacy utilities (e.g. v4l-utils, cec-tools)
# - Avoids excessive QA noise without impacting runtime behavior
#
INSANE_SKIP:append = " 32bit-time"

# Enable dev-friendly settings (root ssh, no password, etc.) Remener to remove for production
IMAGE_FEATURES:append = " debug-tweaks "

DISTRO_FEATURES:append = " rauc"

# HEADLESS + ETH + WIFI + BLE (fast-ish)
DISTRO_FEATURES:remove = "kde wayland opengl gstreamer pipewire pulseaudio "
MACHINE_FEATURES:remove = " splashscreen "

# Optional: reduce rootfs bloat
IMAGE_FEATURES:remove = "package-management"

# ------------------------------------------------------------------
# Fix ST EULA handling for custom machines
# ------------------------------------------------------------------
EULA_FILE_ST = "${OPENSTLINUX_BASE}/files/licenses/ST-Proprietary"
EULA_FILE_ST_MD5SUM = "7cb1e55a9556c7dd1a3cae09db9cc85f"

# Disable ST image license summary for custom TemperCrate images
INHERIT:remove = "st-image-license-summary"
```

## meta-tempercrate-os/conf/layer.conf
```bitbake
# We have a conf and classes directory, add to BBPATH
BBPATH .= ":${LAYERDIR}"
BBPATH:append = ":${LAYERDIR}"

# We have recipes-* directories, add to BBFILES
BBFILES += " \
  ${LAYERDIR}/recipes-*/*/*.bb \
  ${LAYERDIR}/recipes-*/*/*.bbappend \
  ${LAYERDIR}/recipes-*/*/*/*.bb \
  ${LAYERDIR}/recipes-*/*/*/*.bbappend \
"

BBFILE_COLLECTIONS += "tempercrate"
BBFILE_PATTERN_tempercrate = "^${LAYERDIR}/"
BBFILE_PRIORITY_tempercrate = "6"

LAYERDEPENDS_tempercrate = "core openembedded-layer stm-st-stm32mp st-openstlinux"
LAYERSERIES_COMPAT_tempercrate = "scarthgap"

# Absolute path to the meta-tempercrate repo working tree root
TEMPERCRATE_META_REPO_DIR := "${@os.path.abspath(os.path.join(d.getVar('LAYERDIR'), '..'))}"
```
